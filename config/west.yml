## config/west.yml
```yaml
manifest:
  defaults:
    revision: main
  remotes:
    - name: zmkfirmware
      url-base: https://github.com/zmkfirmware
    - name: HeeTuic  
      url-base: https://github.com/HeeTuic    
    - name: efogdev
      url-base: https://github.com/efogdev
  projects:
    - name: zmk
      remote: zmkfirmware
      revision: ac7f75b8591d39aaf3b66b9d26f26c9ed921a009
      import: app/west.yml
    - name: cb-zmk-keebs
      remote: HeeTuic
      revision: zephyr-4.1
      import: config/west.yml
    # Pin the PMW3610 driver to a known-good commit (overrides the
    # zephyr-4.1 branch pulled in by cb-zmk-keebs).
    - name: zmk-pmw3610-driver
      remote: efogdev
      revision: f69a66dc2c19ee182f7212513a9a13c46d5dced9
  self:
    path: config
```
