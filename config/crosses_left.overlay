// Left-hand trackball. Raw XY is sent to the central; scroll conversion and
// scaling happen there (crosses_right.overlay), so layer 4 cursor mode keeps
// full sensor precision.
&trackball_peripheral {
    cpi = <400>;
    x-invert;
    // Natural (trackpad-style) vertical scrolling.
    y-invert;
};

&trackball_peripheral_split {
    input-processors = <&zip_ble_report_rate_limit>;
};
